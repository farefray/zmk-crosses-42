## config/Kconfig
```kconfig
if ZMK_POINTING

config CROSSES_MOTION_GATED_TEMP_LAYER
    bool "Crosses motion-gated temporary layer processor"
    depends on !ZMK_SPLIT || ZMK_SPLIT_ROLE_CENTRAL
    default y
    help
      Require a configurable amount of relative pointer movement before
      forwarding motion to ZMK's temporary-layer input processor.

endif

config CROSSES_KEYPEEK_NOTIFIER
    bool "Crosses KeyPeek Raw HID notifier"
    depends on RAW_HID
    depends on !ZMK_SPLIT || ZMK_SPLIT_ROLE_CENTRAL
    default y
    help
      Send active layers, physical key positions, and explicit modifier state
      to KeyPeek over the Raw HID transport. This is the locally maintained
      Crosses variant of srwi/zmk-keypeek-layer-notifier.
```

## config/dts/bindings/input_processors/zmk,input-processor-motion-gated-temp-layer.yaml
```yaml
# Copyright (c) 2026
# SPDX-License-Identifier: MIT

description: Gate a temporary-layer processor behind a cumulative movement threshold

compatible: "zmk,input-processor-motion-gated-temp-layer"

include: ip_two_param.yaml

properties:
  processor:
    type: phandle
    required: true
    description: Temporary-layer input processor to invoke after the threshold is crossed

  activation-threshold:
    type: int
    required: true
    description: Cumulative absolute X/Y counts required to activate the temporary layer

  activation-window-ms:
    type: int
    required: true
    description: Time window in which movement counts accumulate
```
